## dts/bindings/ethernet/zephyr,ivshmem-eth.yaml
```yaml
# Copyright (c) 2023 Enphase Energy
# SPDX-License-Identifier: Apache-2.0

description: IVSHMEM Ethernet

compatible: "zephyr,ivshmem-eth"

include: [ethernet.yaml, pcie-device.yaml]
```
